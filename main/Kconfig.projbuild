## main/Kconfig.projbuild
```kconfig
menu "MCP9808 Configuration"

config I2C_SCL_IO
    int "I2C SCL GPIO number"
	range 0 34
	default 21
	help
		GPIO number (IOxx) of the SCL pin for the master i2c bus.

config I2C_SDA_IO
    int "I2C SDA GPIO number"
	range 0 34
	default 19
	help
		GPIO number (IOxx) of the SDA pin for the master i2c bus.

config MCP9808_SENSOR_ADDR
    hex "MCP9808 Sensor Address"
	range 0x18 0x1F
	default 0x18
	help
		The MCP9808 sensor address on the i2c bus.

endmenu

menu "Azure Configuration"

config WIFI_SSID
    string "WiFi SSID"
	default "myssid"
	help
		The wireless lan identifier to connect to.

config WIFI_PASSWORD
    string "WiFi Password"
	default "mypassword"
	help
		The wifi password (WPA or WPA2) associated to the SSID.

config AZURE_HOST_NAME
    string "Azure Iot Hub Host Name"
	default "myhub.azure-devices.net"
	help
		The Azure IoT Hub Host Name (from your Azure Portal).

config AZURE_DEVICE_ID
	string "Azure IoT Hub Device Id"
	default "MyEsp32Device"
	help
		The Azure IoT Hub device's Device Id (from your Azure Portal).

config AZURE_DEVICE_PRIMARY_KEY
	string "Azure IoT Hub Device's Primary Key"
	default ""
	help
		The Azure IoT Hub device's primary key (from your Azure Portal).

endmenu
```
